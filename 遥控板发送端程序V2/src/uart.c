#include<stc12c5a60s2.h>
#include "uart.h"
/**************************************************************************
 - 功能描述：51单片机的串口初始化
 - 隶属模块：STC51串口操作
 - 函数属性：外部，使用户使用
 - 参数说明：无
 - 返回说明：无
 - 注：串口是一个最常用的调试查看信息方式，所以正确的初始化串口十分重要
 **************************************************************************/
void uart_init(void)
{
	PCON &= 0x7F;		//波特率不倍速
	SCON = 0x50;		//8位数据,可变波特率
	AUXR |= 0x04;		//独立波特率发生器时钟为Fosc,即1T
	BRT = 0xDC;		//设定独立波特率发生器重装值
	AUXR |= 0x01;		//串口1选择独立波特率发生器为波特率发生器
	AUXR |= 0x10;		//启动独立波特率发生器
    ES = 1;
	EA = 1;
	TI = 1;
}
/**************************************************************************
 - 功能描述：51单片机的串口发送字节的函数
 - 隶属模块：STC51串口操作
 - 函数属性：外部，使用户使用
 - 参数说明：val:要发送的一个字节
 - 返回说明：无
 - 注：发送一个字节，是串口发送的基础操作
 **************************************************************************/
void UART1_SendOneChar(unsigned char val)   
{   
    SBUF = val;   
    while(TI == 0);   
    TI = 0;   			
} 
/**************************************************************************
 - 功能描述：51单片机的串口发送字符串
 - 隶属模块：STC51串口操作
 - 函数属性：外部，使用户使用
 - 参数说明：str:指向字符串的指针
 - 返回说明：无
 **************************************************************************/
void UART1_SendString(unsigned char *str)
{
	while(*str!='\0')
	{
	   UART1_SendOneChar(*str);
	   str++;
	}
}

/******************************************************************
 - 功能描述：将一个32位的变量dat转为字符串，比如把1234转为"1234"
 - 隶属模块：公开函数模块
 - 函数属性：外部，用户可调用
 - 参数说明：dat:带转的long型的变量
             str:指向字符数组的指针，转换后的字节串放在其中           
 - 返回说明：无
 ******************************************************************/
void u32tostr(unsigned long dat,char *str) 
{
 char xdata temp[20]={0,0,0,0,0,0,0,0,0,0,0,0,0,0,0,0,0,0,0,0};
 unsigned char xdata i=0,j=0;
 i=0;
 while(dat)
 {
  temp[i]=dat%10+0x30;
  i++;
  dat/=10;
 }
 j=i;
 for(i=0;i<j;i++)
 {
  str[i]=temp[j-i-1];
 } 
 str[i]='\0';
}

/**************************************************************************
 - 功能描述：51单片机的串口发送数值
 - 隶属模块：STC51串口操作
 - 函数属性：外部，使用户使用
 - 参数说明：dat:要发送的数值
 - 返回说明：无
 - 注：函数中会将数值转为相应的字符串，发送出去。比如 4567 转为 "4567" 
 **************************************************************************/

void UART_Put_Num(unsigned long dat)
{
 char xdata temp[20]={0,0,0,0,0,0,0,0,0,0,0,0,0,0,0,0,0,0,0,0};
 u32tostr(dat,temp);
 UART1_SendString(temp);
}

/**************************************************************************
 - 功能描述：51单片机的串口发送调试信息
 - 隶属模块：STC51串口操作
 - 函数属性：外部，使用户使用
 - 参数说明：inf:指向提示信息字符串的指针
             dat:一个数值，前面的提示信息就是在说明这个数值的意义
 - 返回说明：无
 **************************************************************************/
void UART_Put_Inf(char *inf,unsigned long dat)
{
 UART1_SendString(inf);
 UART_Put_Num(dat);
 UART1_SendString("\n");  
}